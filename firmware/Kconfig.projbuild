## firmware/Kconfig.projbuild
```kconfig
menu "MegaWiFi options"

config MW_HTTP_USE_ESP
	bool "Use esp_http_client (HTTPS-capable)"
	default n
	help
	  If enabled, the firmware uses ESP-IDF's esp_http_client (supports HTTPS).
	  If disabled (default), a minimal plain-HTTP socket client is used to
	  avoid the esp_http_client transport issues seen on some firmware builds.

config MW_AUDIO_ENABLE
	bool "Enable PWM audio subsystem"
	default n
	help
	  If enabled, builds the audio component (Helix MP3 decoder, PWM driver,
	  ring buffer player) and embeds the test MP3 in flash. Disable to save
	  ~1.8 MB of flash and reduce binary size. Requires hardware cap mod
	  (C16/C17 → 10-22nF) for acceptable audio quality.

endmenu
```

## firmware/sdkconfig.defaults
```kconfig
CONFIG_BOOTLOADER_LOG_LEVEL_NONE=y
CONFIG_ESPTOOLPY_FLASHSIZE_4MB=y
CONFIG_PARTITION_TABLE_CUSTOM=y
# OTA removed — single factory partition, no ota_0/ota_1
# CONFIG_ESP_HTTPS_OTA_ALLOW_HTTP is not set
CONFIG_PM_ENABLE=y
CONFIG_PM_DFS_INIT_AUTO=y
CONFIG_ESP_CONSOLE_NONE=y
CONFIG_ESP_CONSOLE_SECONDARY_NONE=y
# CONFIG_ESP_WIFI_NVS_ENABLED is not set
# CONFIG_ESP_WIFI_SOFTAP_SUPPORT is not set
CONFIG_LOG_DEFAULT_LEVEL_NONE=y
# CONFIG_LWIP_IPV6 is not set
CONFIG_LWIP_TCP_MSS=1460
CONFIG_MBEDTLS_TLS_CLIENT_ONLY=y
# HTTPS via esp_http_client with full Mozilla CA bundle (required for finnhub.io / TLS)
CONFIG_MW_HTTP_USE_ESP=y
CONFIG_MBEDTLS_CERTIFICATE_BUNDLE=y
CONFIG_MBEDTLS_CERTIFICATE_BUNDLE_DEFAULT_FULL=y
```
